/ {
  chosen {
    zmk,matrix = &kscan0;
  };

  kscan0: kscan {
    compatible = "zmk,kscan-gpio-matrix";
    label = "KSCAN";

    row-gpios =
      <&gpio0 6 GPIO_ACTIVE_LOW>,
      <&gpio0 8 GPIO_ACTIVE_LOW>,
      <&gpio0 17 GPIO_ACTIVE_LOW>,
      <&gpio0 20 GPIO_ACTIVE_LOW>,
      <&gpio0 22 GPIO_ACTIVE_LOW>;

    col-gpios =
      <&gpio0 13 GPIO_ACTIVE_LOW>,
      <&gpio0 15 GPIO_ACTIVE_LOW>,
      <&gpio0 24 GPIO_ACTIVE_LOW>,
      <&gpio1 0 GPIO_ACTIVE_LOW>,
      <&gpio1 1 GPIO_ACTIVE_LOW>,
      <&gpio1 2 GPIO_ACTIVE_LOW>;

    diode-direction = "col2row";
  };
};

